## git_home/qsdk-ipq4019-linux.git/drivers/net/ethernet/qcom/Kconfig
```kconfig
#
# Qualcomm Ethernet device configuration
#
#

config NET_VENDOR_QCOM
	bool "Qualcomm devices"
	default y
	---help---
	  If you have a network (Ethernet) card belonging to this class, say Y.
	  Otherwise, none of the ethernet devices under this class will be
	  compiled.

if NET_VENDOR_QCOM

config ESSEDMA
	tristate "Qualcomm ESS Edmasupport"
	---help---
	  This driver supports qca961x ethernet edma adapter.
	  Say Y to build this driver.

	  To compile this driver as a module, choose M here. The module
	  will be called essedma.ko.

endif

config HAVE_LACPD_DNI
	tristate " LACPDsupport"
	---help---
	  enable it to support lacp function
```

## git_home/qsdk-ipq4019-linux.git/net/bridge/Kconfig
```kconfig
#
# 802.1d Ethernet Bridging
#

config BRIDGE
	tristate "802.1d Ethernet Bridging"
	select LLC
	select STP
	---help---
	  If you say Y here, then your Linux box will be able to act as an
	  Ethernet bridge, which means that the different Ethernet segments it
	  is connected to will appear as one Ethernet to the participants.
	  Several such bridges can work together to create even larger
	  networks of Ethernets using the IEEE 802.1 spanning tree algorithm.
	  As this is a standard, Linux bridges will cooperate properly with
	  other third party bridge products.

	  In order to use the Ethernet bridge, you'll need the bridge
	  configuration tools; see <file:Documentation/networking/bridge.txt>
	  for location. Please read the Bridge mini-HOWTO for more
	  information.

	  If you enable iptables support along with the bridge support then you
	  turn your bridge into a bridging IP firewall.
	  iptables will then see the IP packets being bridged, so you need to
	  take this into account when setting up your firewall rules.
	  Enabling arptables support when bridging will let arptables see
	  bridged ARP traffic in the arptables FORWARD chain.

	  To compile this code as a module, choose M here: the module
	  will be called bridge.

	  If unsure, say N.

config BRIDGE_IGMP_SNOOPING
	bool "IGMP/MLD snooping"
	depends on BRIDGE
	depends on INET
	default y
	---help---
	  If you say Y here, then the Ethernet bridge will be able selectively
	  forward multicast traffic based on IGMP/MLD traffic received from
	  each port.

	  Say N to exclude this support and reduce the binary size.

	  If unsure, say Y.

config BRIDGE_VLAN_FILTERING
	bool "VLAN filtering"
	depends on BRIDGE
	depends on VLAN_8021Q
	default n
	---help---
	  If you say Y here, then the Ethernet bridge will be able selectively
	  receive and forward traffic based on VLAN information in the packet
	  any VLAN information configured on the bridge port or bridge device.

	  Say N to exclude this support and reduce the binary size.

	  If unsure, say Y.
config DNI_DNS_HIJACK
	tristate "DNI_DNS_HIJACK"
	---help---
	   CONFIG_DNI_DNS_HIJACK

config DNI_CHECK_STAVAP_PACKET
	tristate "DNI_CHECK_STAVAP_PACKET"
	---help---
	   use to record the traffic packet from rooap to extender
config DNI_MCAST_TO_UNICAST
	tristate "DNI_MCAST_TO_UNICAST"
	---help---
	DNI_MCAST_TO_UNICAST
config DNI_MULTI_LAN_SUPPORT
	tristate "DNI_MULTI_LAN_SUPPORT"
	---help---
	DNI_MULTI_LAN_SUPPORT
config DNI_IPTV_MCAST_TO_UNICAST
	tristate "DNI_IPTV_MCAST_TO_UNICAST"
	depends on DNI_MCAST_TO_UNICAST
	---help---
	support wireless multicast to unicast in IPTV mode
config BRIDGE_NETGEAR_ACL
	tristate "NETGEAR feature: block a client from accessing the network"
	---help---
	Block a device according MAC address, If a client is blocked by this function,
	the DHCP and ARP packet will be passed, other packet to/from local, other port will be dropped

config WLAN_BASE_2G_AP_IFNAME
	string "WLAN 2.4G AP Interface"
	depends on BRIDGE_NETGEAR_ACL
	default "ath0"

config WLAN_BASE_5G_AP_IFNAME
	string "WLAN 5G AP Interface"
	depends on BRIDGE_NETGEAR_ACL
	default "ath1"

config WLAN_BASE_2G_BH_AP_IFNAME
	string "WLAN 2.4G Backhual AP Interface"
	depends on BRIDGE_NETGEAR_ACL
	default "ath01"

config WLAN_BASE_5G_BH_AP_IFNAME
	string "WLAN 5G Backhual AP Interface"
	depends on BRIDGE_NETGEAR_ACL
	default "ath2"

config NTGR_GUEST_NETWORK_DHCP_LEASE
	tristate "NETGEAR feature: dhcp lease time for wireless guest network client is 30 minute"
	---help---
	  Change dhcp lease time for wireless guest network client to 30 minutes
```

## package/dni/armor/Config.in
```kconfig
choice
	prompt "Armor version type support"
	default ARMOR_PRO
	help
	  Select the version type of your Armor.

	config ARMOR_PRO
		bool "Support Armor Pro full version"

	config ARMOR_BASIC
		bool "Support Armor Basic version"

endchoice
```

## package/dni/artmtd/Config.in
```kconfig
menu "ART Conofiguration"

config SUPPORT_BOARDDATA2
	int	"The length of Serial Number"
	default 0

config SERIAL_NUMBER_OFFSET
	string 
	prompt "SN offset in art partition"
	default 0x26L

config SERIAL_NUMBER_LENGTH
	int	"The length of Serial Number"
	default 13

config REGION_NUMBER_OFFSET
	string "RN offset in art partition"
	default 0x33L

config REGION_NUMBER_LENGTH
	int "The length of Region Number"
	default 2

config BOARD_HW_ID_OFFSET
	string  "HW ID offset in art partition"
	default 0x35L

config BOARD_HW_ID_LENGTH
	int "The length of board hardware id"
	default 31

config BOARD_MODEL_ID_OFFSET
	string "MODEL ID offset in art partition"
	default 0x54L
	
config BOARD_MODEL_ID_LENGTH
	int "The length of board model id"
	default 16

config REGION_FILE
	string "The file of firmware region"
	default "/tmp/firmware_region"

config BOARD_FRONTHAUL_SSID_OFFSET
	string "HW ID offset in fronthaul partition"
	default 0x64L

config BOARD_FRONTHAUL_SSID_LENGTH
	int "HW ID offset in fronthaul id"
	default 32

config BOARD_BACKHAUL_SSID_OFFSET
	string "HW ID offset in backhaul partition"
	default 0x84L

config BOARD_BACKHAUL_SSID_LENGTH
	int "HW ID offset in backhaul id"
	default 32

config BOARD_FRONTHAUL_PASSPHRASE_OFFSET
	string "HW ID offset in fronthaul passphrase partition"
	default 0x94L

config BOARD_FRONTHAUL_PASSPHRASE_LENGTH
	int "HW ID offset in fronthaul passphrase id"
	default 64

config BOARD_BACKHAUL_PASSPHRASE_OFFSET
	string "HW ID offset in backhaul passphrase partition"
	default 0xd4L

config BOARD_BACKHAUL_PASSPHRASE_LENGTH
	int "PASSPHRASE offset in art id"
	default 64

config BOARD_DATA_OFFSET
	string "data offset in art partition"
	default 0x114L

config BOARD_DATA_LENGTH
	int "data offset in art id"
	default 4

config BOOT_PART_OFFSET
	string "part offset in art partition"
	default 0x118L

config BOOT_PART_LENGTH
	int "part offset in art id"
	default 2

config HW_REVISION_OFFSET
	string "hw_revision offset in art partition"
	default 0x122L

config HW_REVISION_LENGTH
	int "part offset in art id"
	default 2

config ART_SIZE
	string "part offset in art id"
	default 0x10000

config BOARD_BOOT_PARTITION_OFFSET
	int "part offset in art id"
	default 0

config BOARD_BOOT_PARTITION_LENGTH
	int "part offset in art id"
	default 0

config BOARD_MODE_FLAG_OFFSET
       string "mode flag in art id"
       default 0x1L

config BOARD_MODE_FLAG_LENGTH
       int "the length of mode flag"
       default 1

config BOARD_DEFAULT_MODE_FLAG_OFFSET
       string "default mode flag in art id"
       default 0x2L

config BOARD_DEFAULT_MODE_FLAG_LENGTH
       int "the length of default mode flag"
       default 1

config CAL_BLOCK_NUM
	int "CAL BLOCK NUM"
	default 1

config MTD_BLOCK_SIZE
	int "MTD BLOCK SIZE DEFAULT value is 64 * 1024"
	default 65536

endmenu
```

## package/dni/atheros-gpio/Config.in
```kconfig
menu "Configuration"
	depends on PACKAGE_kmod-atheros-gpio

config GPIO_POWER_R
	int "power red led gpio"
	default 64

config GPIO_POWER_G
	int "power green led gpio"
	default 63

config GPIO_LED_R
	int "bottom red led gpio"
	default 54

config GPIO_LED_G
	int "bottom green led gpio"
	default 53

config GPIO_LED_B
	int "bottom blue led gpio"
	default 57

config GPIO_LED_W
	int "bottom white led gpio"
	default 60

config GPIO_I2C_EN
	int "i2c enable gpio"
	default 58

config GPIO_I2C_RST
	int "i2c reset gpio"
	default 59

config GPIO_BTN_RST
	int "button reset gpio"
	default 18

config GPIO_WPS_BTN
	int "WPS gpio"
	default 49

config GPIO_HAVE_USB
	bool "Use DNI git reporitory"
	default n

config GPIO_HAVE_SENSOR
	bool "Use client bridge feature"
	default n

config GPIO_HAVE_TOP_LED
	bool "Display scan result in proc system"
	default n

config GPIO_HAVE_HEATER
	bool "Display scan result in proc system"
	default n

config GPIO_USB_EN
	int "USB gpio"
	default 46
	depends on GPIO_HAVE_USB

config GPIO_TOP_LED_EN
	int "top led gpio"
	default 23
	depends on GPIO_HAVE_TOP_LED

config GPIO_TOP_LED_RST
	int "top led reset gpio"
	default 22
	depends on GPIO_HAVE_TOP_LED

config GPIO_HW_LED_BTN
	int "hw led button gpio"
	default 35
	depends on GPIO_HAVE_TOP_LED

config GPIO_HEATER_EN
	int "heater gpio"
	default 44
	depends on GPIO_HAVE_HEATER

endmenu
```

## package/dni/attached-devices-ext/Config.in
```kconfig
config NETSCANEXT_EXTRA_FLAGS
	string
	prompt "Specify net-scan-ext extra function for different project"
	default ""
	help
	  open marco to enable net-scan-ext extra function
```

## package/dni/attached-devices/Config.in
```kconfig
config NETSCAN_EXTRA_FLAGS
	string
	prompt "Specify net-scan extra function for different project"
	default ""
	help
	  open marco to enable net-scan extra function
```

## package/dni/aws-iot/Config.in
```kconfig
config AWSIOT_EXTRA_FLAGS
	string
	prompt "Specify aws-iot extra function for different project"
	default ""
	help
	  open macro to enable aws-iot extra function
```

## package/dni/datalib/Config.in
```kconfig
# datalib configuration

config DATALIB_MAGIC
	string "Datalib Magic Number"

config DATALIB_RAND_MAGIC
	string "Datalib Rand Number"
```

## package/dni/dniacl/Config.in
```kconfig
config DNIACL_EXTRA_FLAGS
	string
	prompt "Specify dniacl extra function for different project"
	default ""
	help
	  open macro to enable dniacl extra function
```

## package/dni/dnippp/Config.in
```kconfig
config DNI_3G_DONGLE_SUPPORT
	bool "support DNI 3G dongle"
	default n
	help
	  If unsure, say N.
```

## package/dni/soapclient/Config.in
```kconfig
config SOAPCLIENT_EXTRA_FLAGS
	string
	prompt "Specify soapclient extra function for different project"
	default ""
	help
	  open macro to enable soapclient extra function
```
